/*

  HelloWorld.ino
  
  "Hello World" version for U8x8 API

  Universal 8bit Graphics Library (https://github.com/olikraus/u8g2/)

  Copyright (c) 2016, olikraus@gmail.com
  All rights reserved.

  Redistribution and use in source and binary forms, with or without modification, 
  are permitted provided that the following conditions are met:

  * Redistributions of source code must retain the above copyright notice, this list 
    of conditions and the following disclaimer.
    
  * Redistributions in binary form must reproduce the above copyright notice, this 
    list of conditions and the following disclaimer in the documentation and/or other 
    materials provided with the distribution.

  THIS SOFTWARE IS PROVIDED BY THE COPYRIGHT HOLDERS AND 
  CONTRIBUTORS "AS IS" AND ANY EXPRESS OR IMPLIED WARRANTIES, 
  INCLUDING, BUT NOT LIMITED TO, THE IMPLIED WARRANTIES OF 
  MERCHANTABILITY AND FITNESS FOR A PARTICULAR PURPOSE ARE 
  DISCLAIMED. IN NO EVENT SHALL THE COPYRIGHT HOLDER OR 
  CONTRIBUTORS BE LIABLE FOR ANY DIRECT, INDIRECT, INCIDENTAL, 
  SPECIAL, EXEMPLARY, OR CONSEQUENTIAL DAMAGES (INCLUDING, BUT 
  NOT LIMITED TO, PROCUREMENT OF SUBSTITUTE GOODS OR SERVICES; 
  LOSS OF USE, DATA, OR PROFITS; OR BUSINESS INTERRUPTION) HOWEVER 
  CAUSED AND ON ANY THEORY OF LIABILITY, WHETHER IN CONTRACT, 
  STRICT LIABILITY, OR TORT (INCLUDING NEGLIGENCE OR OTHERWISE) 
  ARISING IN ANY WAY OUT OF THE USE OF THIS SOFTWARE, EVEN IF 
  ADVISED OF THE POSSIBILITY OF SUCH DAMAGE.  

*/

#include <Arduino.h>
#include <U8x8lib.h>
#include <U8g2lib.h>
#include <analogWrite.h>

#ifdef U8X8_HAVE_HW_SPI
#include <SPI.h>
#endif

U8X8_SH1106_128X64_NONAME_HW_I2C u8x8(/* reset=*/ U8X8_PIN_NONE);
U8G2_SH1106_128X64_NONAME_F_HW_I2C u8g2(U8G2_R0, /* reset=*/ U8X8_PIN_NONE);

const unsigned char myBitmap [] PROGMEM = {
0x00, 0x00, 0x00, 0x00, 0x00, 0x00, 0x00, 0x00, 0x00, 0x00, 0x00, 0x00, 0x00, 0x00, 0x00, 0x00,
0x00, 0x00, 0x00, 0x00, 0x00, 0x00, 0x00, 0x00, 0x02, 0x00, 0x00, 0x00, 0x00, 0x00, 0x00, 0x00,
0x03, 0x80, 0x00, 0x00, 0x00, 0x00, 0x0c, 0x00, 0x03, 0xe0, 0x00, 0x00, 0x00, 0x00, 0x3c, 0x00,
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0x6a, 0xee, 0xde, 0xa9, 0x57, 0x77, 0xfd, 0x50, 0x00, 0x00, 0x00, 0x00, 0x00, 0x00, 0x00, 0x00,
};

const unsigned char myBitmapRev [] PROGMEM = {
  0x00, 0x00, 0x00, 0x00, 0x00, 0x00, 0x00, 0x00, 0x00, 0x00, 0x00, 0x00, 
  0x00, 0x00, 0x00, 0x00, 0x00, 0x00, 0x00, 0x00, 0x00, 0x00, 0x00, 0x00, 
  0xC0, 0x00, 0x00, 0x00, 0x00, 0x00, 0x10, 0x00, 0xC0, 0x03, 0x00, 0x00, 
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  0xEA, 0x5E, 0xBB, 0x0A, 0x00, 0x12, 0x13, 0x80, 0x28, 0x02, 0x14, 0x00
};

 #define encUA 2
 #define encUB 4

 int counter = 0; 
 int aState;
 int aLastState;  
 bool stateSwitch = false;
 int lastCounter=0;
 int pullSpeed=0;
 int lengthCatheter=0;

void readSwitch()
{
    if(!digitalRead(16))
   {
    if(!stateSwitch)
    {
      stateSwitch = true;
    }
    else
    {
      stateSwitch = false;
    }
   }
}

void encRead()
{     
   readSwitch();
   aState = digitalRead(encUA); // Reads the "current" state of the outputA
   // If the previous and the current state of the outputA are different, that means a Pulse has occured
   if (aState != aLastState){     
     // If the outputB state is different to the outputA state, that means the encoder is rotating clockwise
     if (digitalRead(encUB) != aState) { 
       counter ++;
     } else {
       counter --;
     }
     //Serial.print("Position: ");
     //Serial.println(counter);
   } 
   aLastState = aState; // Updates the previous state of the outputA with the current state
   lastCounter = counter;
}

void display1()
{
  while(!digitalRead(16))
  {
      counter=pullSpeed;
      encRead();
      pullSpeed=counter;
      if(counter>4){counter=1;}
      if(counter<1){counter=4;}
      pullSpeed=counter;
      if(lastCounter != counter){u8g2.clearDisplay();}
      String speedDisp = " >Speed :";
      speedDisp += String(pullSpeed);
      speedDisp += " mm/s";
      u8x8.drawString(0,2,speedDisp.c_str());
      String lengthDisp = "  Length:";
      lengthDisp += String(lengthCatheter);
      lengthDisp += " mm";
      u8x8.drawString(0,3,lengthDisp.c_str());
      u8x8.drawString(0,4,"  Run!");
  }
    counter = 0;
    if(lastCounter != counter){u8g2.clearDisplay();}
    String speedDisp = " >Speed :";
    speedDisp += String(pullSpeed);
    speedDisp += "mm/s";
    u8x8.drawString(0,2,speedDisp.c_str());
    String lengthDisp = "  Length:";
    lengthDisp += String(lengthCatheter);
    lengthDisp += "mm";
    u8x8.drawString(0,3,lengthDisp.c_str());
    u8x8.drawString(0,4,"  Run!");
}


void display2()
{
  while(!digitalRead(16))
  {
      counter=lengthCatheter;
      encRead();
      lengthCatheter=counter;
      if(lastCounter != counter){u8g2.clearDisplay();}
      String speedDisp = "  Speed :";
      speedDisp += String(pullSpeed);
      speedDisp += " mm/s";
      u8x8.drawString(0,2,speedDisp.c_str());
      String lengthDisp = " >Length:";
      lengthDisp += String(lengthCatheter);
      lengthDisp += " mm";
      u8x8.drawString(0,3,lengthDisp.c_str());
      u8x8.drawString(0,4,"  Run!");
  }
    counter = 1;
    if(lastCounter != counter){u8g2.clearDisplay();}
    String speedDisp = "  Speed :";
    speedDisp += String(pullSpeed);
    speedDisp += "mm/s";
    u8x8.drawString(0,2,speedDisp.c_str());
    String lengthDisp = " >Length:";
    lengthDisp += String(lengthCatheter);
    lengthDisp += "mm";
    u8x8.drawString(0,3,lengthDisp.c_str());
    u8x8.drawString(0,4,"  Run!");
}

void display3()
{
    if(lastCounter != counter){u8g2.clearDisplay();}
    String speedDisp = "  Speed :";
    speedDisp += String(pullSpeed);
    speedDisp += "mm/s";
    u8x8.drawString(0,2,speedDisp.c_str());
    String lengthDisp = "  Length:";
    lengthDisp += String(lengthCatheter);
    lengthDisp += "mm";
    u8x8.drawString(0,3,lengthDisp.c_str());
    u8x8.drawString(0,4," >Run!");  

    if(!digitalRead(16))
  {
    analogWrite(19,0);
    analogWrite(18,50*pullSpeed);
    delay((lengthCatheter/pullSpeed)*1000);
    analogWrite(19,0);
    analogWrite(18,0);
  }
}

void mainProgram()
{
   readSwitch();
   encRead();
   switch (counter)
    {
    case 0:
      display1();
      break;
    case 1:
      display2();
      break;
    case 2:
      display3();
      break;
    
    default:
      if(counter>2){counter=0;}
      else{counter=2;}
      break;
    }
}

void setup(void)
{
  // configure LED PWM functionalitites
  // attach the channel to the GPIO to be controlled
  pinMode(18,OUTPUT);
  pinMode(19,OUTPUT);
  pinMode(16,INPUT_PULLUP); //SW
  pinMode(2,INPUT_PULLUP); //CLK
  pinMode(4,INPUT_PULLUP); //DT
  Serial.begin(115200);
  aLastState = digitalRead(encUA); 
  u8g2.begin();
  u8x8.begin();
  u8x8.setPowerSave(0);
  u8x8.setFont(u8x8_font_chroma48medium8_r);
  u8g2.clearBuffer();
  //u8x8.drawString(0,3," Vascular");
  //u8x8.drawString(0,4," Indoneisa!");
  u8g2.drawXBMP(34,0,60,60,myBitmapRev);
  u8g2.sendBuffer();
  //u8x8.refreshDisplay();		// only required for SSD1606/7  
  delay(2000);
  u8g2.clearBuffer();
  u8g2.clearDisplay();
  u8x8.drawString(0,3," Vascular");
  u8x8.drawString(0,4," Indoneisa!");
  delay(1000);
  u8g2.clearDisplay();
  u8x8.drawString(0,2," >Speed  : ");
  u8x8.drawString(0,3,"  Length : ");
  u8x8.drawString(0,4,"  Run!");
}

void loop(void)
{
  mainProgram();
  //analogWrite(19,0);
  //analogWrite(18,50);
  //delay(2000);
  //u8x8.clearDisplay();
}